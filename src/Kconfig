## src/Kconfig
```kconfig
mainmenu "App config"

config NEOPIXEL_PIN
	int "Neopixel date pin"
	default 6
	help
	  Neopixel data pin

config FND_CLK_PIN
	int "FND clock pin"
	default 3
	help
	  FND clock pin

config FND_DIO_PIN
	int "FND data in out pin"
	default 4
	help
	  FND data in out pin

config BTN_NEOPIXEL_MODE_PIN
	int "Neopixel mode select button pin"
	default 12
	help
	  Neopixel mode select pin

config BTN_RESERVE_CONFIRM_PIN
	int "Reserve confirm button pin"
	default 13
	help
	  Reserve confirm button pin

config BTN_RESERVE_UP_PIN
	int "Reserve up button pin"
	default 14
	help
	  Reserve up button pin

config BTN_POWER_PIN
	int "Power on/off button pin"
	default 15
	help
	  Power on/off button pin

config LED_USB_HUB_SW_PIN
	int "Usb Hub power on/off control pin"
	default 5
	help
	  Usb Hub power on/off control pin

config LED_RESERVE_PIN
	int "Reserve indication pin"
	default 10
	help
	  Reserve indication pin

config LED_POWER_PIN
	int "Hub power indication pin"
	default 11
	help
	  Hub power indication pin

config PS2_KEYBOARD_CLK
	int "ps/2 keyboard clk pin"
	default 17
	help
	  ps/2 keyboard clk pin

config PS2_KEYBOARD_DIO
	int "ps/2 keyboard clk pin"
	default 16
	help
	  ps/2 keyboard clk pin

config PS2_KEYBOARD_PWR
	int "ps/2 keyboard clk pin"
	default 18
	help
	  ps/2 keyboard clk pin

config PS2_KEYBOARD_KEYCODE
	hex "ps/2 keyboard key code"
	default 0x76
	help
	  ps/2 keyboard clk pin

config HID_KEYBOARD_KEYCODE
	hex "HID keyboard key code"
	default 0x29
	help
	  ps/2 keyboard clk pin

source "Kconfig.zephyr"
```
